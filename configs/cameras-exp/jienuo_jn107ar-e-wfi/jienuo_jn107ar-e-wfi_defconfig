## configs/cameras-exp/jienuo_jn107ar-e-wfi/jienuo_jn107ar-e-wfi_defconfig
```kconfig
# NAME: JN-107AR-E-WIFI (T31X, SC5235, ETH, RTL8731BU uses RTL8733BU driver)
# MODULE: t31x_sc5235_eth_rtl8733bu
FLASH_SIZE_16=y
BR2_PACKAGE_THINGINO_KOPT_MMC0=y
BR2_PACKAGE_THINGINO_KOPT_MMC0_PB_4BIT=y
# BR2_PACKAGE_THINGINO_KOPT_MMC1=y
# BR2_PACKAGE_THINGINO_KOPT_MMC1_PB_4BIT=y
BR2_PACKAGE_THINGINO_KOPT_MMC=y
BR2_PACKAGE_THINGINO_KOPT_DWC2=y
BR2_PACKAGE_THINGINO_KOPT_DWC2_OTG=y
BR2_PACKAGE_THINGINO_KOPT_JZ_MAC=y
BR2_PACKAGE_THINGINO_KOPT_JZ_MAC_V12=y
BR2_THINGINO_AUDIO=y
BR2_THINGINO_BUTTON=y
BR2_ISP_CLK_200MHZ=y
BR2_SENSOR_PARAMS="sensor_max_fps=15"
BR2_THINGINO_SDCARD=y
BR2_PACKAGE_WIFI=y
BR2_PACKAGE_WIFI_RTL8733BU=y
```

## configs/cameras-exp/jienuo_jn107are_t31x/jienuo_jn107are_t31x_defconfig
```kconfig
# NAME: JN-107AR-E-WIFI (T31X, SC5235, ETH, RTL8731BU uses RTL8733BU driver)
# MODULE: t31x_sc5235_eth_rtl8733bu
FLASH_NOR=y
FLASH_SIZE_16=y
BR2_THINGINO_AUDIO=y
BR2_THINGINO_SDCARD=y
# BR2_THINGINO_BUTTON=y
# BR2_ISP_CLK_200MHZ=y
# BR2_SENSOR_PARAMS="sensor_max_fps=15"
```
